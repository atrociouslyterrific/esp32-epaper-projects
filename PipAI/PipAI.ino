// PipAI - an autonomous digital pet with a real (tiny) neural-network brain.
// For the Waveshare ESP32-S3-ePaper-1.54 (V2).
//
// Every 90 seconds Pip senses its surroundings (temperature, humidity, time of day,
// battery, your pats) and its own needs, and its neural network - trained with
// reinforcement learning on GitHub - decides what to do. Each Pip is born with a
// random personality (curious, playful, lazy, brave, affectionate) that changes
// how it behaves. Everything runs on the board; no internet AI, no API keys.
//
// On screen Pip lives in a little room: it walks to its bed to nap, to its bowl
// to eat, into its box to hide, wanders when exploring, jumps when it plays,
// dances, and gazes out of the window.
//
// Every few minutes Pip says something in a speech bubble.
// Pip can also feel grumpy (woken up), sulky (ignored), scared (flipped / loud noises) or
// frustrated (can't do what it wants). Each feeling fades on its own; snacks and pats help.
//
// Buttons: tap BOOT to drop a snack, tap PWR to pet Pip (it hops). Hold BOOT 5 s to forget Wi-Fi.
// Phone: join "Pip-Setup" Wi-Fi the first time, then open http://pip.local
//
// Files: pip_world.h = Pip's world rules, pip_brain.h = the trained network
// (generated by training/train.py - don't edit by hand).

#include <SPI.h>
#include <Wire.h>
#include <Preferences.h>
#include <WiFi.h>
#include <WebServer.h>
#include <ESPmDNS.h>
#include <DNSServer.h>
#include <GxEPD2_BW.h>
#include <sys/time.h>
#include "pip_world.h"
#include "pip_brain.h"
#include "pip_voice.h"   // Pip's generative voice (trained by training/train_voice.py)
#include "pip_github_roots.h"
#include <WiFiClientSecure.h>
#include <HTTPClient.h>
#include <HTTPUpdate.h>
#include <SD_MMC.h>
#include <esp_now.h>   // short-range radio messages to and from Bloop
#include <esp_wifi.h>
#include <Ticker.h>
#if __has_include("pip_version.h")
#include "pip_version.h"     // written by the GitHub build: this program's version number
#endif
#ifndef PIP_FW_VERSION
#define PIP_FW_VERSION 0
#endif

// The trained brain must fit this version of Pip's world (same senses, same actions).
// If not, stop the build: GitHub retrains the brain and builds again afterwards.
static_assert(PIP_N_IN == PIP_N_FEATURES, "pip_brain.h was trained for a different set of senses - retrain");
static_assert(PIP_N_OUT == PIP_N_ACTIONS, "pip_brain.h was trained for a different set of actions - retrain");
#ifndef PIP_BRAIN_VERSION
#define PIP_BRAIN_VERSION 0
#endif
#ifndef PV_VOICE_VERSION
#define PV_VOICE_VERSION 0
#endif

// ---- Board pins (from Waveshare's example code) ----
const int EPD_PWR = 6, EPD_BUSY = 8, EPD_RST = 9, EPD_DC = 10, EPD_CS = 11, EPD_SCK = 12, EPD_MOSI = 13;
const int VBAT_PWR = 17;  // HIGH keeps the board on when running from battery
const int BAT_ADC = 4;    // battery voltage / 2
const int BTN_BOOT = 0, BTN_PWR = 18;  // pressed = LOW
const int I2C_SDA = 47, I2C_SCL = 48;
const uint8_t SHTC3_ADDR = 0x70, RTC_ADDR = 0x51;

const char *PET_NAME = "Pip";
const char *SETUP_WIFI_NAME = "Pip-Setup";
const char *WEB_NAME = "pip";
// Pip decides what to do every 90 seconds. Each decision is one 3-minute step of the
// world it was trained in, so its needs change about twice as fast as real time.
const unsigned long THINK_EVERY_MS = 90UL * 1000;

GxEPD2_BW<GxEPD2_154_D67, GxEPD2_154_D67::HEIGHT> display(GxEPD2_154_D67(EPD_CS, EPD_DC, EPD_RST, EPD_BUSY));
Preferences prefs, wifiPrefs;
WebServer server(80);
DNSServer dnsServer;

// ---- Pip ----
PipState pip;
PipTraits traits;
PipSenses senses;
int action = A_IDLE;
float actionProbs[PIP_N_ACTIONS];
char reason[64] = "Just woke up!";
unsigned long thoughts = 0;
bool touchedPending = false;
unsigned long lastThink = 0;
int redrawCount = 0;
bool needRedraw = false;
bool haveSensor = false, haveRtc = false, clockSet = false;

struct Key { int8_t y; uint8_t sq; };
struct LineSet { const char **lines; int n; };  // a list of fallback phrases  // animation keyframe: height above floor, squash %

// Declared here, defined further down (used before their sections)
extern float lastReward;
extern char speech[40];
extern unsigned long speechUntil;
extern bool eatingSnack;

#define LOG_LEN 8
struct LogEntry { int action; int hour, minute; };
LogEntry actionLog[LOG_LEN];
int logCount = 0;

// ---- Wi-Fi ----
String savedSsid, savedPass, networkOptions;
bool setupMode = false, wifiWasConnected = false;
unsigned long wifiStartedAt = 0, lastWifiAttempt = 0;

// ================================================================ sensors

bool readSHTC3(float &tempC, float &humidity) {
  auto cmd = [](uint16_t c) {
    Wire.beginTransmission(SHTC3_ADDR);
    Wire.write(c >> 8);
    Wire.write(c & 0xFF);
    return Wire.endTransmission() == 0;
  };
  if (!cmd(0x3517)) return false;  // wake
  delay(1);
  if (!cmd(0x7866)) return false;  // measure, T first
  delay(20);
  if (Wire.requestFrom(SHTC3_ADDR, (uint8_t)6) != 6) return false;
  uint16_t rawT = (Wire.read() << 8) | Wire.read(); Wire.read();
  uint16_t rawH = (Wire.read() << 8) | Wire.read(); Wire.read();
  cmd(0xB098);  // sleep
  tempC = -45.0f + 175.0f * rawT / 65536.0f;
  humidity = 100.0f * rawH / 65536.0f;
  return true;
}

uint8_t bcd2dec(uint8_t v) { return (v >> 4) * 10 + (v & 0x0F); }
uint8_t dec2bcd(uint8_t v) { return ((v / 10) << 4) | (v % 10); }

// Read hour/minute from the PCF85063 clock chip. Returns false if never set.
bool readRtc(int &hour, int &minute) {
  Wire.beginTransmission(RTC_ADDR);
  Wire.write(0x04);
  if (Wire.endTransmission(false) != 0) return false;
  if (Wire.requestFrom(RTC_ADDR, (uint8_t)7) != 7) return false;
  uint8_t sec = Wire.read(), min = Wire.read(), hr = Wire.read();
  Wire.read(); Wire.read(); Wire.read();
  uint8_t yr = Wire.read();
  if (sec & 0x80) return false;          // oscillator stopped: time not valid
  if (bcd2dec(yr) < 25) return false;    // never set
  minute = bcd2dec(min & 0x7F);
  hour = bcd2dec(hr & 0x3F);
  return true;
}

void writeRtc(int year, int month, int day, int weekday, int hour, int minute, int second) {
  Wire.beginTransmission(RTC_ADDR);
  Wire.write(0x04);
  Wire.write(dec2bcd(second));
  Wire.write(dec2bcd(minute));
  Wire.write(dec2bcd(hour));
  Wire.write(dec2bcd(day));
  Wire.write(weekday);
  Wire.write(dec2bcd(month));
  Wire.write(dec2bcd(year % 100));
  Wire.endTransmission();
}

void readSenses() {
  float t, h;
  haveSensor = readSHTC3(t, h);
  senses.tempC = haveSensor ? t : 21.0f;
  senses.humidity = haveSensor ? h : 45.0f;

  int hr = 12, mn = 0;
  clockSet = readRtc(hr, mn);
  senses.hour = hr + mn / 60.0f;

  // Battery: no battery (USB only) reads as nonsense, so treat that as "plugged in, full".
  float v = analogReadMilliVolts(BAT_ADC) * 2 / 1000.0f;
  if (v > 4.3f || v < 2.8f) {
    senses.battery = 1.0f;
    senses.charging = 1;
  } else {
    senses.battery = pip_clamp01((v - 3.3f) / (4.15f - 3.3f));
    senses.charging = 0;
  }
  senses.sound = 0.0f;   // microphone hearing comes in a later version
  senses.orient = 0;     // no tilt sensor yet
  senses.touched = touchedPending ? 1 : 0;
  touchedPending = false;
}

// ================================================================ brain

int sampleAction(const float *logits) {
  float mx = logits[0];
  for (int i = 1; i < PIP_N_ACTIONS; i++) mx = max(mx, logits[i]);
  float sum = 0;
  for (int i = 0; i < PIP_N_ACTIONS; i++) {
    actionProbs[i] = expf(logits[i] - mx);
    sum += actionProbs[i];
  }
  for (int i = 0; i < PIP_N_ACTIONS; i++) actionProbs[i] /= sum;
  float r = (esp_random() / 4294967296.0f), acc = 0;
  for (int i = 0; i < PIP_N_ACTIONS; i++) {
    acc += actionProbs[i];
    if (r < acc) return i;
  }
  return PIP_N_ACTIONS - 1;
}

// A short human explanation of why Pip probably chose this.
// Which negative feeling (if any) is strongest right now: 0 grumpy, 1 sulky, 2 scared,
// 3 frustrated, or -1 if Pip feels fine.
enum Feeling { F_NONE = -1, F_GRUMPY, F_SULKY, F_SCARED, F_FRUSTRATED };
int strongestFeeling(float threshold) {
  float v[4] = {pip.grumpy, pip.sulky, pip.scared, pip.frustrated};
  int best = -1;
  for (int i = 0; i < 4; i++) if (v[i] > threshold && (best < 0 || v[i] > v[best])) best = i;
  return best;
}

void explain(int a) {
  bool night = senses.hour >= 22 || senses.hour < 7;
  const char *r = "";
  switch (strongestFeeling(0.35f)) {  // a strong feeling colours everything
    case F_GRUMPY:     snprintf(reason, sizeof(reason), "%s", pip.prevAction == A_NAP ? "Hmph. I was napping!" : "Feeling grumpy..."); return;
    case F_SULKY:      snprintf(reason, sizeof(reason), "%s", "Not talking to you. Hmph."); return;
    case F_SCARED:     snprintf(reason, sizeof(reason), "%s", "Eek! That was scary!"); return;
    case F_FRUSTRATED: snprintf(reason, sizeof(reason), "%s", "Grr, it's not working!"); return;
    default: break;
  }
  switch (a) {
    case A_NAP:
      r = pip.energy < 0.4f ? "I'm so tired..." : night ? "It's night-time, zzz" : traits.lazy > 0.6f ? "Naps are the best" : "Just resting my eyes";
      break;
    case A_EAT:
      r = pip.food < 0.4f ? "My tummy is rumbling!" : "Snack time!";
      break;
    case A_EXPLORE:
      r = pip.novelty > 0.3f ? "Something changed! Let me see" : traits.curious > 0.6f ? "What's over there?" : "Having a little wander";
      break;
    case A_PLAY:
      r = pip.touchRecent > 0.3f ? "Play with me!" : "Bouncing around for fun";
      break;
    case A_SING:
      r = pip.touchRecent > 0.3f ? "A song for you!" : "La la la~";
      break;
    case A_HIDE:
      r = senses.orient >= 2 ? "Whoa, everything's tilted!" : traits.brave < 0.35f ? "Feeling shy..." : "Hiding in my box";
      break;
    case A_WARM_UP:
      r = senses.tempC < 18 ? "Brr, it's cold in here" : "Getting cosy";
      break;
    case A_COOL_DOWN:
      r = senses.tempC > 26 ? "Phew, it's hot!" : "Cooling off";
      break;
    case A_CALL:
      r = senses.battery < 0.3f && !senses.charging ? "My battery is low! Charge me?" :
          pip.social < 0.4f ? "Hello? Anyone there?" : "Hey! Over here!";
      break;
    case A_DANCE:
      r = pip.touchRecent > 0.3f ? "Dancing for you!" : traits.playful > 0.6f ? "Can't stop the groove" : "Dance break!";
      break;
    case A_WINDOW:
      r = (clockSet && (senses.hour >= 20 || senses.hour < 7)) ? "Looking at the moon" :
          traits.curious > 0.6f ? "What's out there?" : "Watching the sky";
      break;
    default:
      r = pip.comfort > 0.7f ? "Life is good" : "Just hanging out";
  }
  snprintf(reason, sizeof(reason), "%s", r);
}

void think() {
  readSenses();
  pip_observe(&pip, &senses);
  float x[PIP_N_FEATURES], logits[PIP_N_ACTIONS];
  pip_features(&pip, &senses, &traits, x);
  brainForward(x, logits);  // the trained brain plus whatever Pip has learned on the board
  action = sampleAction(logits);
  explain(action);
  float night = (clockSet && (senses.hour >= 22 || senses.hour < 7)) ? 1.0f : 0.0f;
  pip_act(&pip, &senses, &traits, action);
  lastReward = pip_reward(&pip, &traits, action, night);
  learnFrom(action, lastReward);  // nudge the brain toward choices that turned out well
  thoughts++;
  diaryWrite(action, lastReward);

  int hr = (int)senses.hour, mn = (int)((senses.hour - hr) * 60);
  memmove(&actionLog[1], &actionLog[0], sizeof(LogEntry) * (LOG_LEN - 1));
  actionLog[0] = {action, hr, mn};
  if (logCount < LOG_LEN) logCount++;

  saveState();
  Serial.printf("[%02d:%02d] %.1fC %.0f%% bat %.2f | food %.2f energy %.2f fun %.2f comfort %.2f social %.2f -> %s (%.0f%%) \"%s\"\n",
                hr, mn, senses.tempC, senses.humidity, senses.battery, pip.food, pip.energy, pip.fun, pip.comfort,
                pip.social, PIP_ACTION_NAMES[action], actionProbs[action] * 100, reason);
  startAction(action);
  needRedraw = true;
}

// ================================================================ learning on the board
// Pip keeps learning from its own life. After each decision it scores how things went
// (the same reward it was trained with) and nudges the brain's last layer: choices that
// went better than usual become a bit more likely, worse ones a bit less (REINFORCE).
// What it learns is saved, and is reset when a new brain version arrives from GitHub.

float liveW3[PIP_N_OUT * PIP_N_HID], liveB3[PIP_N_OUT];
float lastH2[PIP_N_HID];
float rewardBaseline = 0, recentReward = 0, lastReward = 0;
bool baselineSet = false;
unsigned long learnSteps = 0;
const float LEARN_RATE = 0.002f;   // small steps: Pip changes slowly, over days
const float MAX_DRIFT = 1.0f;      // never drift further than this from the trained brain
Preferences learnPrefs;

void brainForward(const float *x, float *logits) {
  pip_hidden(x, lastH2);   // layers 1-2 (8-bit weights from training)
  pip_dense(liveW3, liveB3, lastH2, PIP_N_HID, PIP_N_OUT, logits, 0);  // layer 3, which keeps learning
}

void saveLearning() {
  learnPrefs.putUInt("ver", PIP_BRAIN_VERSION);
  learnPrefs.putBytes("w3", liveW3, sizeof(liveW3));
  learnPrefs.putBytes("b3", liveB3, sizeof(liveB3));
  learnPrefs.putFloat("base", rewardBaseline);
  learnPrefs.putFloat("recent", recentReward);
  learnPrefs.putULong("steps", learnSteps);
}

void loadLearning() {
  memcpy(liveW3, PIP_W3, sizeof(liveW3));
  memcpy(liveB3, PIP_B3, sizeof(liveB3));
  learnPrefs.begin("learn", false);
  if (learnPrefs.getUInt("ver", 0xFFFFFFFF) == (uint32_t)PIP_BRAIN_VERSION &&
      learnPrefs.getBytesLength("w3") == sizeof(liveW3) && learnPrefs.getBytesLength("b3") == sizeof(liveB3)) {
    learnPrefs.getBytes("w3", liveW3, sizeof(liveW3));
    learnPrefs.getBytes("b3", liveB3, sizeof(liveB3));
    rewardBaseline = learnPrefs.getFloat("base", 0);
    recentReward = learnPrefs.getFloat("recent", 0);
    learnSteps = learnPrefs.getULong("steps", 0);
    baselineSet = learnSteps > 0;
    Serial.printf("Loaded %lu steps of on-board learning\n", learnSteps);
  } else {
    Serial.println("New brain version: on-board learning starts fresh");
  }
}

void learnFrom(int a, float r) {
  if (!baselineSet) { rewardBaseline = recentReward = r; baselineSet = true; }
  float adv = constrain(r - rewardBaseline, -1.0f, 1.0f);   // better or worse than usual?
  rewardBaseline += 0.02f * (r - rewardBaseline);
  recentReward += 0.05f * (r - recentReward);
  for (int i = 0; i < PIP_N_OUT; i++) {
    float g = LEARN_RATE * adv * (((i == a) ? 1.0f : 0.0f) - actionProbs[i]);
    for (int k = 0; k < PIP_N_HID; k++) {
      int j = i * PIP_N_HID + k;
      liveW3[j] = constrain(liveW3[j] + g * lastH2[k], PIP_W3[j] - MAX_DRIFT, PIP_W3[j] + MAX_DRIFT);
    }
    liveB3[i] = constrain(liveB3[i] + g, PIP_B3[i] - MAX_DRIFT, PIP_B3[i] + MAX_DRIFT);
  }
  learnSteps++;
  if (learnSteps % 10 == 0) saveLearning();
}

// How far on-board learning has moved the brain (0 = not at all).
float learnedDrift() {
  float d = 0;
  for (int j = 0; j < PIP_N_OUT * PIP_N_HID; j++) d += fabsf(liveW3[j] - PIP_W3[j]);
  return d / (PIP_N_OUT * PIP_N_HID);
}

// ================================================================ diary on the microSD card
// Every decision goes into /pip/diary.csv and everything Pip says into /pip/sayings.txt.
// Download them from the phone page, or read the card on a computer.
bool sdOk = false;

void startSD() {
  SD_MMC.setPins(39, 41, 40);                    // CLK, CMD, D0 (1-bit mode, from Waveshare's example)
  sdOk = SD_MMC.begin("/sdcard", true);
  if (!sdOk) { Serial.println("No microSD card (diary off)"); return; }
  SD_MMC.mkdir("/pip");
  if (SD_MMC.exists("/pip/diary.csv")) {  // older diaries didn't have the feelings columns
    File f = SD_MMC.open("/pip/diary.csv", FILE_READ);
    String header = f ? f.readStringUntil('\n') : "";
    if (f) f.close();
    if (header.indexOf("grumpy") < 0) { SD_MMC.remove("/pip/diary-old.csv"); SD_MMC.rename("/pip/diary.csv", "/pip/diary-old.csv"); }
  }
  if (!SD_MMC.exists("/pip/diary.csv")) {
    File f = SD_MMC.open("/pip/diary.csv", FILE_WRITE);
    if (f) { f.println("thought,time,temp_c,humidity,battery,petted,food,energy,fun,comfort,love,grumpy,sulky,scared,frustrated,action,chance,reward,brain_version"); f.close(); }
  }
  Serial.printf("microSD card: %llu MB, diary on\n", SD_MMC.cardSize() / (1024 * 1024));
}

void diaryWrite(int a, float r) {
  if (!sdOk) return;
  File f = SD_MMC.open("/pip/diary.csv", FILE_APPEND);
  if (!f) return;
  int hr = (int)senses.hour, mn = (int)((senses.hour - hr) * 60);
  f.printf("%lu,%s%02d:%02d,%.1f,%.0f,%.2f,%d,%.3f,%.3f,%.3f,%.3f,%.3f,%.3f,%.3f,%.3f,%.3f,%s,%.2f,%.3f,%d\n", thoughts,
           clockSet ? "" : "~", hr, mn, senses.tempC, senses.humidity, senses.battery, senses.touched,
           pip.food, pip.energy, pip.fun, pip.comfort, pip.social, pip.grumpy, pip.sulky, pip.scared, pip.frustrated,
           PIP_ACTION_NAMES[a], actionProbs[a], r,
           PIP_BRAIN_VERSION);
  f.close();
}

void diarySaid(const char *text) {
  if (!sdOk) return;
  File f = SD_MMC.open("/pip/sayings.txt", FILE_APPEND);
  if (!f) return;
  int hr = (int)senses.hour, mn = (int)((senses.hour - hr) * 60);
  f.printf("%s%02d:%02d  %s\n", clockSet ? "" : "~", hr, mn, text);
  f.close();
}

// ================================================================ updating itself over Wi-Fi
// Every hour Pip asks GitHub for the newest version number. If it's newer than this
// program, it downloads the update over HTTPS (checked against GitHub's real
// certificates, see pip_github_roots.h), installs it into the spare slot and restarts.
const char *UPDATE_BASE = "https://github.com/atrociouslyterrific/esp32-epaper-projects/releases/download/latest/";
unsigned long nextUpdateCheck = 3UL * 60 * 1000;   // first check 3 minutes after starting
String updateStatus = "not checked yet";
int latestVersion = -1;

int fetchLatestVersion() {
  WiFiClientSecure client;
  client.setCACert(GITHUB_ROOT_CAS);
  HTTPClient http;
  http.setFollowRedirects(HTTPC_STRICT_FOLLOW_REDIRECTS);
  http.setTimeout(15000);
  if (!http.begin(client, String(UPDATE_BASE) + "PipAI.version")) return -1;
  int code = http.GET();
  int v = -1;
  if (code == 200) v = http.getString().toInt();
  else Serial.printf("Update check: HTTP %d\n", code);
  http.end();
  return v > 0 ? v : -1;
}

void checkForUpdate() {
  if (WiFi.status() != WL_CONNECTED || setupMode) { updateStatus = "waiting for Wi-Fi"; return; }
  latestVersion = fetchLatestVersion();
  if (latestVersion < 0) { updateStatus = "couldn't reach GitHub"; return; }
  if (latestVersion <= PIP_FW_VERSION) { updateStatus = "up to date"; return; }

  Serial.printf("Updating from version %d to %d\n", PIP_FW_VERSION, latestVersion);
  snprintf(reason, sizeof(reason), "Updating myself to v%d...", latestVersion);
  snprintf(speech, sizeof(speech), "Brb, getting smarter!");
  speechUntil = millis() + 600000UL;
  saveState();
  saveLearning();
  drawScreen();

  WiFiClientSecure client;
  client.setCACert(GITHUB_ROOT_CAS);
  httpUpdate.setFollowRedirects(HTTPC_STRICT_FOLLOW_REDIRECTS);
  httpUpdate.rebootOnUpdate(true);  // restarts into the new version when it's done
  t_httpUpdate_return ret = httpUpdate.update(client, String(UPDATE_BASE) + "PipAI-ota.bin");
  if (ret == HTTP_UPDATE_FAILED) {
    updateStatus = "update failed: " + httpUpdate.getLastErrorString();
    Serial.println(updateStatus);
    snprintf(reason, sizeof(reason), "Update failed, retry tomorrow");
    speech[0] = 0;
    needRedraw = true;
  }
}

void updateTick() {
  if (millis() < nextUpdateCheck) return;
  nextUpdateCheck = millis() + 60UL * 60 * 1000;  // then every hour (GitHub trains every hour)
  checkForUpdate();
}

// ================================================================ saving

void saveState() {
  prefs.putBytes("state", &pip, sizeof(pip));
  prefs.putInt("action", action);
  prefs.putULong("thoughts", thoughts);
}

void loadOrBirth() {
  if (prefs.getBytesLength("traits") == sizeof(traits)) {
    prefs.getBytes("traits", &traits, sizeof(traits));
  } else {  // a new Pip is born with a random personality
    float *t = &traits.curious;
    for (int i = 0; i < 5; i++) t[i] = esp_random() / 4294967296.0f;
    prefs.putBytes("traits", &traits, sizeof(traits));
    Serial.println("A new Pip is born!");
  }
  if (prefs.getBytesLength("state") == sizeof(pip)) {
    prefs.getBytes("state", &pip, sizeof(pip));
    action = prefs.getInt("action", A_IDLE);
    thoughts = prefs.getULong("thoughts", 0);
    snprintf(reason, sizeof(reason), "I'm back!");
  } else {
    pip_init(&pip, 0.8f, 0.8f, 0.8f, 0.8f, 0.8f);
    snprintf(reason, sizeof(reason), "Hello world! I'm new here.");
  }
}

// Describe the personality in a few words, e.g. "curious & lazy".
String personalityWords() {
  const char *names[5] = {"curious", "playful", "lazy", "brave", "cuddly"};
  const float *t = &traits.curious;
  int a = 0, b = 1;
  if (t[b] > t[a]) { a = 1; b = 0; }
  for (int i = 2; i < 5; i++) {
    if (t[i] > t[a]) { b = a; a = i; }
    else if (t[i] > t[b]) b = i;
  }
  String s = names[a];
  if (t[b] > 0.5f) s += String(" & ") + names[b];
  if (traits.brave < 0.2f) s += ", shy";
  return s;
}

// ================================================================ drawing + movement
// Pip is a squishy blob living in a little room: a bed (left), a food bowl and a cardboard box (right),
// and a window that shows the sun or the moon. Pip walks to the right place for
// each action and jumps when it plays or gets petted.

const int FLOOR_Y = 106, BLOB_RX = 19, BLOB_RY = 16;
const int BED_X = 28, BOWL_X = 140, BOX_X = 181;
const int WALK_STEP = 7;                // pixels per frame when sliding along
const int FULL_REFRESH_AFTER = 150;     // clear e-paper ghosting, but only while Pip is resting

enum AnimMode { AN_REST, AN_WALK, AN_PERFORM };
AnimMode animMode = AN_REST;
int pipX = 100, pipJump = 0, squash = 100, facing = 1, legPhase = 0, targetX = 100;
int performStep = 0, exploreHops = 0, partialsSinceFull = 0;
bool fullRefreshDue = false;
unsigned long nextFrameAt = 0, nextAmbientAt = 0;

// Squash-and-stretch keyframes: {height above floor, squash %}.
// squash > 100 = wider and flatter (landing), < 100 = taller and thinner (taking off).
const Key K_PLAY[] = {{0,128},{-7,80},{-17,90},{-22,100},{-17,94},{-7,84},{0,132},{0,108},
                      {0,124},{-8,80},{-18,92},{-22,100},{-14,90},{0,130},{0,106},{0,100}};
const Key K_HOP[]  = {{0,124},{-8,84},{-12,96},{-6,90},{0,126},{0,106},{0,100}};
const Key K_CALL[] = {{0,120},{-6,86},{-9,96},{0,124},{-6,86},{-9,96},{0,120},{0,100}};
const Key K_SING[] = {{0,106},{-1,94},{0,106},{-1,94},{0,106},{0,100}};
const Key K_DANCE[] = {{0,120},{-6,86},{0,124},{-3,92},{0,118},{-8,84},{-12,96},{0,128},{0,110},{-6,86},{0,124},{0,100}};
const Key K_LOOK[]  = {{0,96},{-2,92},{-2,92},{0,98},{0,100}};  // stretches up to see out
const Key K_EAT[]  = {{0,112},{0,96},{0,112},{0,96},{0,100}};
const Key K_SHIVER[] = {{0,104},{0,98},{0,104},{0,98},{0,100}};
const Key *keys = nullptr;
int keyLen = 0;

void drawArc(int cx, int cy, int halfWidth, int curve, int thick) {
  for (int t = 0; t < thick; t++) {
    int px = cx - halfWidth, py = cy + t;
    for (int x = -halfWidth + 1; x <= halfWidth; x++) {
      float k = 1.0f - (float)(x * x) / (halfWidth * halfWidth);
      int y = cy + t + (int)(curve * k);
      display.drawLine(px, py, cx + x, y, GxEPD_BLACK);
      px = cx + x; py = y;
    }
  }
}

void drawNote(int x, int y) {
  display.fillCircle(x, y, 2, GxEPD_BLACK);
  display.drawLine(x + 2, y, x + 2, y - 8, GxEPD_BLACK);
  display.drawLine(x + 2, y - 8, x + 6, y - 6, GxEPD_BLACK);
}

void printAt(const char *text, int x, int y, int size) {
  display.setFont(); display.setTextSize(size); display.setTextColor(GxEPD_BLACK);
  display.setCursor(x, y); display.print(text);
}

void printCentered(const char *text, int y, int size) {
  printAt(text, (200 - (int)strlen(text) * 6 * size) / 2, y, size);
}

void drawBar(int y, const char *label, float v) {
  printAt(label, 4, y, 1);
  display.drawRect(50, y, 146, 8, GxEPD_BLACK);
  display.fillRect(52, y + 2, (int)(142 * v), 4, GxEPD_BLACK);
}

void drawRoom() {
  bool night = clockSet && (senses.hour >= 20 || senses.hour < 7);
  // Window with the sun or moon (it knows the time from the clock chip)
  display.drawRect(86, 18, 30, 24, GxEPD_BLACK);
  display.drawLine(101, 18, 101, 41, GxEPD_BLACK);
  display.drawLine(86, 30, 115, 30, GxEPD_BLACK);
  if (night) {
    display.fillCircle(94, 24, 4, GxEPD_BLACK);
    display.fillCircle(96, 23, 4, GxEPD_WHITE);
    display.drawPixel(109, 22, GxEPD_BLACK); display.drawPixel(107, 36, GxEPD_BLACK); display.drawPixel(92, 37, GxEPD_BLACK);
  } else {
    display.drawCircle(94, 24, 3, GxEPD_BLACK);
    for (int i = 0; i < 8; i++) {
      float a = i * PI / 4;
      display.drawPixel(94 + (int)(6 * cosf(a)), 24 + (int)(6 * sinf(a)), GxEPD_BLACK);
    }
  }
  // Floor
  display.drawLine(0, FLOOR_Y, 199, FLOOR_Y, GxEPD_BLACK);
  for (int x = 4; x < 200; x += 14) display.drawLine(x, FLOOR_Y + 3, x + 4, FLOOR_Y + 3, GxEPD_BLACK);
  // Bed
  display.fillRect(4, 80, 3, FLOOR_Y - 80, GxEPD_BLACK);
  display.drawRect(4, 97, 48, 9, GxEPD_BLACK);
  display.fillRoundRect(9, 90, 16, 8, 3, GxEPD_BLACK);
  display.fillRoundRect(11, 92, 12, 4, 2, GxEPD_WHITE);
  // Food bowl
  display.fillRoundRect(BOWL_X - 10, 99, 20, 7, 3, GxEPD_BLACK);
  display.fillCircle(BOWL_X - 5, 98, 2, GxEPD_BLACK);
  display.fillCircle(BOWL_X + 1, 97, 2, GxEPD_BLACK);
  display.fillCircle(BOWL_X + 6, 98, 2, GxEPD_BLACK);
  // Cardboard box (back edges)
  display.drawRect(BOX_X - 15, 84, 30, 22, GxEPD_BLACK);
  display.drawLine(BOX_X - 15, 84, BOX_X - 21, 77, GxEPD_BLACK);
  display.drawLine(BOX_X + 14, 84, BOX_X + 19, 77, GxEPD_BLACK);
}

void drawBoxFront(int cx, int cy) {
  display.fillRect(BOX_X - 15, cy + 1, 30, FLOOR_Y - cy - 1, GxEPD_WHITE);
  display.drawRect(BOX_X - 15, cy + 1, 30, FLOOR_Y - cy, GxEPD_BLACK);
  display.drawRect(BOX_X - 14, cy + 2, 28, FLOOR_Y - cy - 2, GxEPD_BLACK);
}

// A blob: round on top, flatter and wider where it sits on the floor.
void fillBlob(int cx, int bottom, int rx, int ry, uint16_t color) {
  int cy = bottom - ry;
  for (int dy = -ry; dy <= ry; dy++) {
    float t = (float)dy / ry, k = 1.0f - t * t;
    if (k < 0) k = 0;
    float hw = dy < 0 ? rx * sqrtf(k) : rx * sqrtf(sqrtf(k));
    int w = (int)(hw + 0.5f);
    if (w > 0) display.drawFastHLine(cx - w, cy + dy, 2 * w + 1, color);
  }
}

void drawPip(int a, bool sad) {
  bool walk = animMode == AN_WALK;
  bool onBed = pipX < 52 && (a == A_NAP || a == A_WARM_UP) && !walk;
  int rx = BLOB_RX * squash / 100, ry = BLOB_RY * 100 / squash;
  int cx = pipX + ((!walk && pip.scared > 0.35f) ? (millis() / 120 % 2 ? 1 : -1) : 0);  // scared: trembling
  int bottom = (onBed ? 97 : FLOOR_Y) + pipJump;
  int cy = bottom - ry, top = bottom - 2 * ry;
  int side = cx > 130 ? -1 : 1;  // which side extra bits (notes, "!") go on

  // Shadow on the floor while in the air
  if (pipJump < -2) {
    int sw = rx - (-pipJump) / 3;
    for (int x = -sw; x <= sw; x += 2) display.drawPixel(cx + x, (onBed ? 97 : FLOOR_Y) - 1, GxEPD_BLACK);
  }
  // Body: thick outline, a little tip on top that trails behind when moving, and a shine
  int lean = walk ? -facing * 3 : (pipJump < -4 ? 0 : 1);
  display.fillTriangle(cx - 3, top + 3, cx + 3, top + 3, cx + lean, top - 4, GxEPD_BLACK);
  fillBlob(cx, bottom, rx, ry, GxEPD_BLACK);
  fillBlob(cx, bottom - 2, rx - 2, ry - 2, GxEPD_WHITE);
  drawArc(cx - rx / 2 - 1, top + ry / 2, 3, -2, 1);

  int ey = cy - 1, look = facing * 2, gap = 7 * rx / BLOB_RX;
  int el = cx - gap + look, er = cx + gap + look;
  int my = cy + 6 * 100 / squash;
  int feel = walk ? F_NONE : strongestFeeling(0.35f);
  if (feel == F_GRUMPY) {
    display.drawLine(el - 3, ey, el + 3, ey, GxEPD_BLACK);          // half-shut eyes
    display.drawLine(er - 3, ey, er + 3, ey, GxEPD_BLACK);
    display.drawLine(el - 4, ey - 6, el + 3, ey - 3, GxEPD_BLACK);  // cross brows
    display.drawLine(er + 4, ey - 6, er - 3, ey - 3, GxEPD_BLACK);
    display.drawLine(cx - 4, my, cx + 4, my, GxEPD_BLACK);          // flat mouth
    // a tiny storm cloud
    display.fillCircle(cx - 4, top - 10, 4, GxEPD_BLACK); display.fillCircle(cx + 3, top - 11, 5, GxEPD_BLACK);
    display.drawLine(cx, top - 6, cx - 2, top - 2, GxEPD_BLACK); display.drawLine(cx - 2, top - 2, cx + 1, top - 2, GxEPD_BLACK);
  } else if (feel == F_SULKY) {
    // facing away: the back of a blob has no face, just a "..." over its head
    for (int i = 0; i < 3; i++) display.fillCircle(cx - 6 + i * 6, top - 6, 1, GxEPD_BLACK);
  } else if (feel == F_SCARED) {
    display.drawCircle(el, ey, 4, GxEPD_BLACK); display.drawCircle(er, ey, 4, GxEPD_BLACK);  // wide eyes
    display.fillCircle(el, ey, 1, GxEPD_BLACK); display.fillCircle(er, ey, 1, GxEPD_BLACK);
    drawArc(cx, my, 5, 0, 1); drawArc(cx - 2, my + 1, 2, -1, 1); drawArc(cx + 2, my + 1, 2, -1, 1);  // wobbly mouth
    display.fillTriangle(cx + rx - 3, top + 1, cx + rx - 6, top + 7, cx + rx, top + 7, GxEPD_BLACK);  // sweat drop
    display.fillCircle(cx + rx - 3, top + 8, 3, GxEPD_BLACK);
  } else if (feel == F_FRUSTRATED) {
    display.fillCircle(el, ey, 2, GxEPD_BLACK); display.fillCircle(er, ey, 2, GxEPD_BLACK);
    display.drawLine(el - 4, ey - 5, el + 3, ey - 3, GxEPD_BLACK);
    display.drawLine(er + 4, ey - 5, er - 3, ey - 3, GxEPD_BLACK);
    for (int x = -5; x < 5; x += 2) display.drawLine(cx + x, my + ((x / 2) % 2 ? 1 : -1), cx + x + 2, my + ((x / 2) % 2 ? -1 : 1), GxEPD_BLACK);  // gritted teeth
    display.drawCircle(cx - rx + 2, top - 3, 2, GxEPD_BLACK); display.drawCircle(cx - rx - 2, top - 8, 3, GxEPD_BLACK);  // steam
    display.drawCircle(cx + rx - 2, top - 3, 2, GxEPD_BLACK); display.drawCircle(cx + rx + 2, top - 8, 3, GxEPD_BLACK);
  } else if (walk || a == A_EXPLORE) {  // eyes look where Pip is going
    display.fillCircle(el, ey, 3, GxEPD_BLACK); display.fillCircle(er, ey, 3, GxEPD_BLACK);
    display.drawPixel(el + facing, ey - 1, GxEPD_WHITE); display.drawPixel(er + facing, ey - 1, GxEPD_WHITE);
    drawArc(cx + look, my, 4, 2, 1);
    if (a == A_EXPLORE && !walk) printAt("?", cx + side * (rx + 3) - (side < 0 ? 6 : 0), top - 4, 1);
  } else switch (a) {
    case A_NAP:
      drawArc(el, ey, 3, 2, 1); drawArc(er, ey, 3, 2, 1);
      display.fillCircle(cx + look, my + 1, 1, GxEPD_BLACK);
      printAt("z", cx + rx + 1, top + 2, 1);
      printAt("Z", cx + rx + 6, top - 8, 1);
      break;
    case A_EAT:
      display.fillCircle(el, ey, 3, GxEPD_BLACK); display.fillCircle(er, ey, 3, GxEPD_BLACK);
      if (squash > 100) display.fillCircle(cx + look + facing * 2, my, 3, GxEPD_BLACK);  // chomp
      else drawArc(cx + look + facing * 2, my, 3, 1, 2);
      break;
    case A_PLAY:
      drawArc(el, ey + 1, 3, -3, 1); drawArc(er, ey + 1, 3, -3, 1);
      drawArc(cx + look, my - 1, 7, 4, 2);
      break;
    case A_SING:
      drawArc(el, ey + 1, 3, -2, 1); drawArc(er, ey + 1, 3, -2, 1);
      display.drawCircle(cx + look, my + 1, squash < 100 ? 3 : 2, GxEPD_BLACK);
      drawNote(cx + side * (rx + 4) - (side < 0 ? 6 : 0), cy - 4 - (squash < 100 ? 3 : 0));
      drawNote(cx + side * (rx + 11) - (side < 0 ? 6 : 0), cy - 12 + (squash < 100 ? 3 : 0));
      break;
    case A_WARM_UP:
      display.fillCircle(el, ey, 2, GxEPD_BLACK); display.fillCircle(er, ey, 2, GxEPD_BLACK);
      drawArc(cx, my, 5, 1, 1);
      for (int i = 0; i < 2; i++) {
        display.drawLine(cx - rx - 6, cy - 4 + i * 7, cx - rx - 2, cy - 6 + i * 7, GxEPD_BLACK);
        display.drawLine(cx + rx + 2, cy - 6 + i * 7, cx + rx + 6, cy - 4 + i * 7, GxEPD_BLACK);
      }
      if (onBed) {  // tucked under a blanket
        display.fillRect(cx - rx - 3, cy + 3, 2 * rx + 6, bottom - cy - 3, GxEPD_WHITE);
        display.drawRect(cx - rx - 3, cy + 3, 2 * rx + 6, bottom - cy - 3, GxEPD_BLACK);
        for (int x = cx - rx + 1; x < cx + rx; x += 6) display.drawLine(x, cy + 5, x + 3, cy + 8, GxEPD_BLACK);
      }
      break;
    case A_COOL_DOWN:
      display.fillCircle(el, ey, 3, GxEPD_BLACK); display.fillCircle(er, ey, 3, GxEPD_BLACK);
      drawArc(cx + look, my, 5, -1, 1);
      display.fillTriangle(cx + rx - 4, top + 3, cx + rx - 7, top + 9, cx + rx - 1, top + 9, GxEPD_BLACK);
      display.fillCircle(cx + rx - 4, top + 10, 3, GxEPD_BLACK);
      break;
    case A_CALL: {
      display.fillCircle(el, ey, 3, GxEPD_BLACK); display.fillCircle(er, ey, 3, GxEPD_BLACK);
      display.fillCircle(cx + look, my, 3, GxEPD_BLACK);
      int bx = cx + side * (rx + 3) - (side < 0 ? 10 : 0);
      display.fillRoundRect(bx, top - 6, 10, 14, 3, GxEPD_BLACK);
      display.setFont(); display.setTextSize(1); display.setTextColor(GxEPD_WHITE);
      display.setCursor(bx + 3, top - 2); display.print("!");
      break;
    }
    case A_DANCE:
      drawArc(el, ey + 1, 3, -3, 1); drawArc(er, ey + 1, 3, -3, 1);   // ^ ^
      display.fillCircle(cx + look, my, 3, GxEPD_BLACK);              // singing along
      drawNote(cx - rx - 10, cy - 6 + (pipJump < 0 ? -4 : 0));
      drawNote(cx + rx + 4, cy - 10 + (pipJump < 0 ? 0 : -4));
      break;
    case A_WINDOW:  // gazing up at the window
      display.fillCircle(cx - gap, ey - 2, 3, GxEPD_BLACK); display.fillCircle(cx + gap, ey - 2, 3, GxEPD_BLACK);
      display.drawPixel(cx - gap, ey - 4, GxEPD_WHITE); display.drawPixel(cx + gap, ey - 4, GxEPD_WHITE);
      display.drawCircle(cx, my + 1, 2, GxEPD_BLACK);                 // "ooh"
      display.drawPixel(cx - 8, top - 6, GxEPD_BLACK); display.drawPixel(cx + 9, top - 9, GxEPD_BLACK);  // sparkles
      display.drawPixel(cx - 7, top - 7, GxEPD_BLACK); display.drawPixel(cx + 10, top - 8, GxEPD_BLACK);
      break;
    default:  // idle and hide
      display.fillCircle(el, ey, 3, GxEPD_BLACK); display.fillCircle(er, ey, 3, GxEPD_BLACK);
      display.drawPixel(el + 1, ey - 1, GxEPD_WHITE); display.drawPixel(er + 1, ey - 1, GxEPD_WHITE);
      if (a != A_HIDE) drawArc(cx + look, my - 1, 6, sad ? -3 : 3, 2);
  }
  if (sad && a != A_NAP && !walk && feel == F_NONE) {
    display.drawLine(el - 4, ey - 7, el + 2, ey - 5, GxEPD_BLACK);
    display.drawLine(er + 4, ey - 7, er - 2, ey - 5, GxEPD_BLACK);
  }
  if (a == A_PLAY && !walk) {  // the ball bounces opposite to Pip
    int by = FLOOR_Y - 6 - (pipJump < -10 ? 0 : 14 + pipJump / 2);
    display.drawCircle(cx + side * (rx + 12), by, 6, GxEPD_BLACK);
    display.drawLine(cx + side * (rx + 12) - 6, by, cx + side * (rx + 12) + 6, by, GxEPD_BLACK);
  }
  if (a == A_HIDE && !walk && abs(pipX - BOX_X) < 6) drawBoxFront(cx, cy);
}

// ---- snacks: tap BOOT and a berry drops into the room; Pip scoots over and eats it
int snackX = -1, snackDropY = 0, snackFallSpeed = 0, snackBounces = 0;
bool eatingSnack = false, snackFalling = false;
unsigned long snackCount = 0;

void drawSnack() {
  if (snackX < 0) return;
  int y = FLOOR_Y - 5 - snackDropY;
  display.fillCircle(snackX, y, 4, GxEPD_BLACK);              // a berry
  display.drawPixel(snackX - 1, y - 2, GxEPD_WHITE);           // shine
  display.drawLine(snackX, y - 4, snackX + 2, y - 8, GxEPD_BLACK);  // stem
  display.fillTriangle(snackX + 2, y - 8, snackX + 6, y - 9, snackX + 4, y - 6, GxEPD_BLACK);  // leaf
  if (snackFalling && snackDropY > 8) {  // speed lines while it falls
    for (int i = -1; i <= 1; i++) display.drawLine(snackX + i * 4, y - 12, snackX + i * 4, y - 12 - min(18, snackFallSpeed), GxEPD_BLACK);
  }
  if (snackFalling && snackDropY == 0) {  // a little "thud" on landing
    display.drawLine(snackX - 9, FLOOR_Y - 2, snackX - 6, FLOOR_Y - 4, GxEPD_BLACK);
    display.drawLine(snackX + 9, FLOOR_Y - 2, snackX + 6, FLOOR_Y - 4, GxEPD_BLACK);
  }
}

// One frame of the snack falling from the top of the room (it speeds up, then bounces).
// Returns true while it's still falling.
bool snackFallFrame() {
  if (!snackFalling) return false;
  if (snackDropY > 0) {
    snackDropY = max(0, snackDropY - snackFallSpeed);
    snackFallSpeed += 9;                       // gravity
  } else if (snackBounces < 2) {
    snackDropY = snackBounces == 0 ? 6 : 2;    // bounce, then a smaller bounce
    snackFallSpeed = 6;
    snackBounces++;
  } else {
    snackFalling = false;                      // landed: now Pip notices and scoots over
    snprintf(reason, sizeof(reason), "A snack! For me?!");
    targetX = constrain(snackX + (snackX > pipX ? -14 : 14), 16, 184);
    exploreHops = 0;
    animMode = AN_WALK;
  }
  return true;
}

void dropSnack() {
  if (snackX >= 0) return;  // one snack at a time
  do { snackX = randomX(16, 184); } while (abs(snackX - pipX) < 20);
  snackDropY = FLOOR_Y - 5 - 20;   // starts at the top of the room
  snackFallSpeed = 6;
  snackBounces = 0;
  snackFalling = true;
  eatingSnack = true;
  touchedPending = true;  // being fed counts as attention from you
  action = A_EAT;
  snprintf(reason, sizeof(reason), "Something's falling!");
  animMode = AN_REST;     // Pip waits and watches until it lands
  pipJump = 0;
  squash = 100;
  facing = snackX > pipX ? 1 : -1;
  nextFrameAt = millis();
  needRedraw = true;
}

void finishSnack() {
  eatingSnack = false;
  snackX = -1;
  snackCount++;
  pip.food = pip_clamp01(pip.food + 0.2f);
  pip.grumpy *= 0.5f; pip.frustrated *= 0.5f; pip.sulky *= 0.7f;  // a treat helps bad moods
  pip.fun = pip_clamp01(pip.fun + 0.03f);
  saveState();
  snprintf(reason, sizeof(reason), "Yum! Thank you!");
  speak(pip.food > 0.85f ? 'J' : 'H', 8000);
}

// ================================================================ Bloop comes to visit
// Bloop is the pet on the other board (bloop_room in the esp32-s3-touch-lcd-3.5c
// repo). Pip calls out over the radio a few times a second. When Bloop's board
// hears Pip loud and clear, the boards are side by side: Pip hops into Bloop's
// room on Bloop's screen, Bloop answers, and Bloop shows up in Pip's room here.

// The radio message. Must match the copy in bloop_room/visitor.h.
struct __attribute__((packed)) PalMsg {
  uint8_t magic[4];   // "PAL1"
  uint8_t who;        // PAL_PIP or PAL_BLOOP
  uint8_t action;     // what the sender is doing (its own action number)
  uint8_t flags;      // PALF_* bits about the sender
  uint8_t hosting;    // Bloop: 1 while Pip is in Bloop's room
};
enum : uint8_t { PAL_PIP = 1, PAL_BLOOP = 2 };
enum : uint8_t { PALF_SAD = 1, PALF_ASLEEP = 2 };

bool bloopHere = false;                 // the boards are together right now
volatile uint32_t bloopHeardMs = 0;     // written by the radio, read by loop()
volatile bool bloopHosting = false;
volatile uint8_t bloopFlags = 0;
volatile uint8_t palAction = 0, palFlags = 0;   // what Pip tells Bloop about itself
uint8_t bloopFlagsDrawn = 0;
bool palReady = false;
Ticker palTicker;
const uint8_t PAL_EVERYONE[6] = {0xFF, 0xFF, 0xFF, 0xFF, 0xFF, 0xFF};

// Bloop in black and white: a dark blob with pointy ears, feet and a pale belly.
// It stands next to Pip.
void drawBloopGuest() {
  const int r = 15;
  int cx = constrain(pipX > 100 ? pipX - 46 : pipX + 46, 22, 178);
  int cy = FLOOR_Y - 3 - r, top = cy - r;
  int look = pipX > cx ? 2 : -2;
  bool asleep = bloopFlags & PALF_ASLEEP, sad = bloopFlags & PALF_SAD;

  display.fillCircle(cx - 7, FLOOR_Y - 4, 4, GxEPD_BLACK);   // feet
  display.fillCircle(cx + 7, FLOOR_Y - 4, 4, GxEPD_BLACK);
  int tip = sad ? top + 4 : top - 6, out = sad ? 19 : 12;    // ears droop when it's sad
  display.fillTriangle(cx - 12, cy - 6, cx - 3, top + 2, cx - out, tip, GxEPD_BLACK);
  display.fillTriangle(cx + 12, cy - 6, cx + 3, top + 2, cx + out, tip, GxEPD_BLACK);
  display.fillCircle(cx, cy, r, GxEPD_BLACK);                // body
  display.fillCircle(cx, cy + 6, 7, GxEPD_WHITE);            // belly
  for (int s = -1; s <= 1; s += 2) {                         // eyes
    int ex = cx + s * 6;
    if (asleep) { display.drawLine(ex - 3, cy - 4, ex + 3, cy - 4, GxEPD_WHITE); continue; }
    display.fillCircle(ex, cy - 4, 4, GxEPD_WHITE);
    display.fillCircle(ex + look, cy - 4, 2, GxEPD_BLACK);
  }
  if (!asleep) drawArc(cx, cy + (sad ? 6 : 3), 3, sad ? -2 : 2, 1);   // mouth
  else { printAt("z", cx + r + 1, top + 2, 1); printAt("Z", cx + r + 6, top - 8, 1); }
  printAt("Bloop", constrain(cx - 15, 1, 169), top - (asleep ? 26 : 18), 1);
}

void drawScreen() {
  redrawCount++;
  bool full = redrawCount == 1 || (fullRefreshDue && animMode == AN_REST);
  if (full) { display.setFullWindow(); partialsSinceFull = 0; fullRefreshDue = false; }
  else {
    display.setPartialWindow(0, 0, display.width(), display.height());
    if (++partialsSinceFull >= FULL_REFRESH_AFTER) fullRefreshDue = true;
  }

  bool sad = min(min(pip.food, pip.energy), min(pip.fun, min(pip.comfort, pip.social))) < 0.25f;
  char header[40], right[24], label[24], line1[34];
  String words = personalityWords();
  snprintf(header, sizeof(header), "%s: %s", PET_NAME, words.c_str());
  int hr = (int)senses.hour, mn = (int)((senses.hour - hr) * 60);
  if (clockSet) snprintf(right, sizeof(right), "%.0fC %02d:%02d", senses.tempC, hr, mn);
  else snprintf(right, sizeof(right), "%.0fC", senses.tempC);
  if (animMode == AN_WALK) snprintf(label, sizeof(label), "%s", "WALKING");
  else snprintf(label, sizeof(label), "%s", PIP_ACTION_NAMES[action]);
  for (char *p = label; *p; p++) *p = (*p == '_') ? ' ' : toupper(*p);
  snprintf(line1, sizeof(line1), "%.32s", reason);

  display.firstPage();
  do {
    display.fillScreen(GxEPD_WHITE);
    printAt(header, 2, 2, 1);
    printAt(right, 198 - (int)strlen(right) * 6, 2, 1);
    display.drawLine(0, 12, 199, 12, GxEPD_BLACK);
    drawRoom();
    drawSnack();
    if (bloopHere) drawBloopGuest();
    drawPip(action, sad);
    drawSpeech();
    printCentered(label, 111, 2);
    printCentered(line1, 129, 1);
    drawBar(141, "FOOD", pip.food);
    drawBar(151, "ENERGY", pip.energy);
    drawBar(161, "FUN", pip.fun);
    drawBar(171, "COMFY", pip.comfort);
    drawBar(181, "LOVE", pip.social);
  } while (display.nextPage());
  display.hibernate();
}

int randomX(int lo, int hi) { return lo + (int)(esp_random() % (uint32_t)(hi - lo + 1)); }

int targetFor(int a) {
  switch (a) {
    case A_NAP: case A_WARM_UP: return BED_X;
    case A_EAT: return BOWL_X - 26;
    case A_HIDE: return BOX_X;
    case A_COOL_DOWN: return 70;
    case A_SING: case A_CALL: return 100;
    case A_PLAY: return randomX(60, 130);
    case A_EXPLORE: return randomX(20, 170);
    case A_DANCE: return randomX(60, 140);
    case A_WINDOW: return 101;  // right under the window
    default: return pipX;
  }
}

void setKeys(const Key *k, int n) { keys = k; keyLen = n; performStep = 0; }

void beginPerform() {
  animMode = AN_PERFORM;
  setKeys(nullptr, 0);
  if (action == A_PLAY) setKeys(K_PLAY, sizeof(K_PLAY) / sizeof(Key));
  else if (action == A_CALL) setKeys(K_CALL, sizeof(K_CALL) / sizeof(Key));
  else if (action == A_SING) setKeys(K_SING, sizeof(K_SING) / sizeof(Key));
  else if (action == A_EAT) { facing = (snackX >= 0) ? (snackX > pipX ? 1 : -1) : 1; setKeys(K_EAT, sizeof(K_EAT) / sizeof(Key)); }
  else if (action == A_WARM_UP) setKeys(K_SHIVER, sizeof(K_SHIVER) / sizeof(Key));
  else if (action == A_DANCE) setKeys(K_DANCE, sizeof(K_DANCE) / sizeof(Key));
  else if (action == A_WINDOW) setKeys(K_LOOK, sizeof(K_LOOK) / sizeof(Key));
}

// Called by think(): walk to where this action happens, then do it.
void startAction(int a) {
  if (eatingSnack) return;  // finish the snack first; the brain decides again next time
  exploreHops = (a == A_EXPLORE) ? 2 : 0;
  targetX = targetFor(a);
  if (abs(targetX - pipX) > 4) animMode = AN_WALK;
  else beginPerform();
  nextFrameAt = millis();
}

// A happy little hop (when petted, or just because).
void startHop() {
  animMode = AN_PERFORM;
  setKeys(K_HOP, sizeof(K_HOP) / sizeof(Key));
  nextFrameAt = millis();
}

void restNow() {
  animMode = AN_REST;
  pipJump = 0;
  squash = 100;
  keys = nullptr;
  bool still = action == A_NAP || action == A_HIDE || action == A_WARM_UP;
  nextAmbientAt = millis() + (still ? 60000UL : 8000UL + esp_random() % 12000UL);  // little moves every 8-20 s
  if (fullRefreshDue) needRedraw = true;  // a good moment to clean the screen
}

// One animation frame. Returns true if the screen needs redrawing.
bool animFrame() {
  if (animMode == AN_WALK) {
    // Blobs don't walk, they scoot: stretch forward, then squash down, a little hop each time
    int dx = targetX - pipX;
    facing = dx > 0 ? 1 : -1;
    pipX += facing * min(WALK_STEP, abs(dx));
    legPhase ^= 1;
    squash = legPhase ? 86 : 116;
    pipJump = legPhase ? -3 : 0;
    if (abs(targetX - pipX) <= 1) {
      pipX = targetX;
      if (exploreHops > 0) {  // explorers check out a few spots
        exploreHops--;
        targetX = randomX(20, 170);
      } else {
        squash = 118; pipJump = 0;  // land
        beginPerform();
      }
    }
    return true;
  }
  if (animMode == AN_PERFORM) {
    if (keys && performStep < keyLen) {
      pipJump = keys[performStep].y;
      squash = keys[performStep].sq;
      performStep++;
      if (action == A_PLAY && pipJump <= -20) facing = -facing;  // turns in the air
      if (action == A_DANCE) facing = (performStep % 2) ? 1 : -1;  // dances side to side
      return true;
    }
    bool settle = squash != 100 || pipJump != 0 || performStep == 0;
    if (eatingSnack) finishSnack();
    restNow();
    return settle;
  }
  return false;
}

// Little things Pip does on its own between thoughts.
void ambient() {
  if (millis() < nextAmbientAt) return;
  bool still = action == A_NAP || action == A_HIDE || action == A_WARM_UP;
  if (still) { nextAmbientAt = millis() + 60000UL; return; }
  uint32_t r = esp_random() % 4;
  if (r == 0) {
    startHop();
  } else if (r == 1) {
    facing = -facing;
    needRedraw = true;
    restNow();
  } else if (r == 2) {  // a little wobble
    animMode = AN_PERFORM;
    setKeys(K_SING, sizeof(K_SING) / sizeof(Key));
    nextFrameAt = millis();
  } else {
    targetX = constrain(pipX + (int)(esp_random() % 60) - 30, 16, 184);
    exploreHops = 0;
    animMode = AN_WALK;
    nextFrameAt = millis();
  }
}

// Run from loop(): advance the animation when it's time.
void animTick() {
  if (snackFalling) {
    if (millis() < nextFrameAt) return;
    if (snackFallFrame()) needRedraw = true;
    nextFrameAt = millis();
    return;
  }
  if (animMode == AN_REST) { ambient(); return; }
  if (millis() < nextFrameAt) return;
  if (animFrame()) needRedraw = true;
  nextFrameAt = millis();  // next frame as soon as the screen is ready (about 3 per second)
}

// ================================================================ talking
// Every few minutes Pip says something that fits the moment: how it feels, the
// time of day, the temperature, whether you just petted it, and its personality.
// The words are GENERATED on the board by a tiny language model (pip_voice.h),
// so Pip comes up with new sentences rather than repeating a list.

char speech[40] = "";  // up to 31 characters fit in the bubble
unsigned long speechUntil = 0, nextSpeechAt = 30000;

static const char *L_SLEEP[]   = {"zzz... berries...", "mmm... five more mins", "*snore*", "zzz... boing..."};
static const char *L_HUNGRY[]  = {"Is it snack o'clock?", "My tummy says hi", "Food? Food!"};
static const char *L_TIRED[]   = {"So... sleepy...", "Yawwwn", "Need a nap"};
static const char *L_LONELY[]  = {"Where did you go?", "I miss you!", "Anyone there?"};
static const char *L_BORED[]   = {"I'm sooo bored", "Play with me?", "Nothing to do..."};
static const char *L_COLD[]    = {"Brr! Chilly!", "Is the heater on?", "Cold toes!"};
static const char *L_HOT[]     = {"It's toasty in here", "Phew, so hot!", "I'm melting!"};
static const char *L_NIGHT[]   = {"The moon is pretty", "Shh, it's late", "Night night"};
static const char *L_MORNING[] = {"Good morning!", "Rise and wiggle!", "New day!"};
static const char *L_PETTED[]  = {"Hehe, that tickles!", "I like you!", "More pats!", "Again! Again!"};
static const char *L_CURIOUS[] = {"What's in the box?", "Ooh, what's that?", "I wonder..."};
static const char *L_PLAYFUL[] = {"Bet I jump higher!", "Boing boing!", "Catch me!"};
static const char *L_LAZY[]    = {"Naps are life", "Too comfy to move", "Five more minutes"};
static const char *L_BRAVE[]   = {"I fear nothing!", "Adventure time!"};
static const char *L_SHY[]     = {"...hi", "Don't look at me", "*hides a bit*"};
static const char *L_CUDDLY[]  = {"You're my favourite!", "Hug?", "Love you lots!"};
static const char *L_HAPPY[]   = {"Blub!", "I'm a happy blob", "Wiggle wiggle", "What a nice day"};
#define LINES(a) a, (int)(sizeof(a) / sizeof(a[0]))

// Fallback phrases, used only if the voice model writes something in the wrong format.
LineSet fallbackFor(char mood) {
  switch (mood) {
    case 'S': return {LINES(L_SLEEP)};   case 'H': return {LINES(L_HUNGRY)};  case 'T': return {LINES(L_TIRED)};
    case 'L': return {LINES(L_LONELY)};  case 'B': return {LINES(L_BORED)};   case 'K': return {LINES(L_COLD)};
    case 'W': return {LINES(L_HOT)};     case 'N': return {LINES(L_NIGHT)};   case 'M': return {LINES(L_MORNING)};
    case 'P': return {LINES(L_PETTED)};  case 'C': return {LINES(L_CURIOUS)}; case 'Y': return {LINES(L_PLAYFUL)};
    case 'Z': return {LINES(L_LAZY)};    case 'R': return {LINES(L_BRAVE)};   case 'X': return {LINES(L_SHY)};
    case 'A': return {LINES(L_CUDDLY)};  default:  return {LINES(L_HAPPY)};
  }
}

float voiceRand01() { return esp_random() / 4294967296.0f; }

// Pip writes a brand-new sentence for this mood with its voice model, one letter at a time.
void speak(char mood, unsigned long ms) {
  // Whatever the model writes is shown, as long as it's a proper sentence:
  // not empty, finished before running off the bubble, and only normal characters
  // (lowercase letters, spaces and ! ? . , ' ~ * < 3), not mood codes.
  const int MAX_CHARS = 31;  // the widest bubble that fits on the 200-pixel screen
  char text[MAX_CHARS + 2];
  bool ok = false;
  for (int attempt = 0; attempt < 5 && !ok; attempt++) {
    int n = pv_generate(mood, text, MAX_CHARS + 1, 0.75f, voiceRand01);
    ok = n >= 1 && n <= MAX_CHARS;
    for (int i = 0; ok && i < n; i++) ok = strchr("abcdefghijklmnopqrstuvwxyz !?.,'~*<3", text[i]) != nullptr;
  }
  if (!ok) {
    LineSet f = fallbackFor(mood);
    snprintf(text, sizeof(text), "%s", f.lines[esp_random() % f.n]);
  } else if (text[0] >= 'a' && text[0] <= 'z') {
    text[0] -= 32;  // capital first letter
  }
  snprintf(speech, sizeof(speech), "%s", text);
  diarySaid(speech);
  speechUntil = millis() + ms;
  needRedraw = true;
  Serial.printf("Pip says (%c%s): \"%s\"\n", mood, ok ? "" : ", fallback", speech);
}

void speakSomething() {
  char moods[12];
  int n = 0;
  bool night = clockSet && (senses.hour >= 22 || senses.hour < 6);
  bool morning = clockSet && senses.hour >= 6 && senses.hour < 10;
  const char FEEL_MOOD[4] = {'G', 'U', 'F', 'Q'};
  int feel = strongestFeeling(0.35f);
  if (feel >= 0 && esp_random() % 10 < 7) { speak(FEEL_MOOD[feel], 15000); return; }
  if (action == A_NAP) { speak('S', 20000); return; }
  if (action == A_DANCE && esp_random() % 3 != 0) { speak('D', 15000); return; }
  if (action == A_WINDOW && esp_random() % 3 != 0) { speak('V', 15000); return; }
  // Things Pip is feeling right now come first...
  if (pip.food < 0.3f) moods[n++] = 'H';
  if (pip.energy < 0.3f) moods[n++] = 'T';
  if (pip.social < 0.3f) moods[n++] = 'L';
  if (pip.fun < 0.3f) moods[n++] = 'B';
  if (haveSensor && senses.tempC < 18) moods[n++] = 'K';
  if (haveSensor && senses.tempC > 27) moods[n++] = 'W';
  if (night) moods[n++] = 'N';
  if (morning) moods[n++] = 'M';
  // ...otherwise its personality talks (or it's just a happy blob)
  if (n == 0 || esp_random() % 3 == 0) {
    if (traits.curious > 0.6f) moods[n++] = 'C';
    if (traits.playful > 0.6f) moods[n++] = 'Y';
    if (traits.lazy > 0.6f) moods[n++] = 'Z';
    if (traits.brave > 0.7f) moods[n++] = 'R';
    if (traits.brave < 0.3f) moods[n++] = 'X';
    if (traits.affectionate > 0.6f) moods[n++] = 'A';
    moods[n++] = 'J';
  }
  speak(moods[esp_random() % n], 20000);
}

void sayPetted() { speak('P', 8000); }

// Run from loop(): start talking now and then, and stop when the bubble's time is up.
void speechTick() {
  if (speech[0] && millis() > speechUntil) { speech[0] = 0; needRedraw = true; }
  if (millis() < nextSpeechAt || animMode != AN_REST || speech[0]) return;
  speakSomething();
  nextSpeechAt = millis() + 90000UL + esp_random() % 150000UL;  // every 1.5-4 minutes
}

// A speech bubble above Pip with a little tail pointing at it.
void drawSpeech() {
  if (!speech[0]) return;
  bool onBed = pipX < 52 && (action == A_NAP || action == A_WARM_UP) && animMode != AN_WALK;
  int ry = BLOB_RY * 100 / squash;
  int top = (onBed ? 97 : FLOOR_Y) + pipJump - 2 * ry - 5;
  int w = strlen(speech) * 6 + 10, h = 13;
  int x = constrain(pipX - w / 2, 1, 199 - w);
  int y = max(14, top - h - 7);
  int tx = constrain(pipX, x + 6, x + w - 6);
  display.fillRoundRect(x, y, w, h, 4, GxEPD_WHITE);
  display.drawRoundRect(x, y, w, h, 4, GxEPD_BLACK);
  display.fillTriangle(tx - 3, y + h - 1, tx + 3, y + h - 1, tx, y + h + 5, GxEPD_WHITE);
  display.drawLine(tx - 3, y + h - 1, tx, y + h + 5, GxEPD_BLACK);
  display.drawLine(tx + 3, y + h - 1, tx, y + h + 5, GxEPD_BLACK);
  printAt(speech, x + 5, y + 3, 1);
}

// ================================================================ phone page

const char PAGE_HTML[] PROGMEM = R"rawliteral(<!doctype html>
<html><head><meta charset="utf-8"><meta name="viewport" content="width=device-width,initial-scale=1">
<title>Pip</title><style>
body{font-family:-apple-system,system-ui,sans-serif;max-width:440px;margin:0 auto;padding:16px;background:#f4f1ea;color:#222}
h1{margin:0;font-size:26px}.sub{color:#666;margin-bottom:12px}
.card{background:#fff;border:2px solid #222;border-radius:14px;padding:14px;margin:12px 0}
.act{font-size:28px;font-weight:700;text-transform:capitalize}.why{font-style:italic;margin-top:4px}
.row{display:flex;align-items:center;gap:8px;margin:6px 0}.row span{width:96px;font-size:14px}
.bar{flex:1;height:12px;border:2px solid #222;border-radius:6px;overflow:hidden}.fill{height:100%;background:#222}
.t .fill{background:#8a6d3b}h2{font-size:16px;margin:0 0 8px}
button{width:100%;font-size:20px;padding:14px;border:2px solid #222;border-radius:12px;background:#fff}
.btns{display:grid;grid-template-columns:1fr 1fr;gap:10px}button.small{font-size:16px;padding:10px}
#brain{line-height:1.6}#files a{color:#222;margin-right:14px}
ul{margin:0;padding-left:18px}small{color:#666}
</style></head><body>
<h1 id="name">Pip</h1><div class="sub" id="pers"></div>
<div class="card"><div class="act" id="act">...</div><div class="why" id="why"></div>
<small id="conf"></small></div>
<div class="card"><h2>Feelings</h2><div id="needs"></div></div>
<div class="card"><h2>Senses</h2><div id="senses"></div></div>
<div class="card t"><h2>Personality</h2><div id="traits"></div></div>
<div class="card"><h2>Recently</h2><ul id="log"></ul></div>
<div class="btns"><button onclick="pet()">Pet Pip</button><button onclick="snack()">Give a snack</button></div>
<div class="card"><h2>Pip's brain</h2><div id="brain"></div>
<p><button class="small" onclick="upd()">Check for updates</button></p>
<p id="files"></p></div>
<script>
const $=id=>document.getElementById(id);
function bars(el,obj){el.innerHTML=Object.entries(obj).map(([k,v])=>`<div class="row"><span>${k}</span><div class="bar"><div class="fill" style="width:${Math.round(v*100)}%"></div></div></div>`).join('')}
function show(s){
 $('name').textContent=s.name;$('pers').textContent=s.personality+' · '+s.thoughts+' thoughts';
 $('act').textContent=s.action.replace('_',' ');$('why').textContent=s.reason;
 $('conf').textContent='Brain was '+Math.round(s.confidence*100)+'% sure';
 bars($('needs'),{food:s.food,energy:s.energy,fun:s.fun,comfort:s.comfort,love:s.social});
 const bad=Object.entries({grumpy:s.grumpy,sulky:s.sulky,scared:s.scared,frustrated:s.frustrated}).filter(([k,v])=>v>0.03);
 if(bad.length){const d=document.createElement('div');d.innerHTML='<h2 style="margin-top:12px">Bad moods</h2>';$('needs').append(d);const b=document.createElement('div');bars(b,Object.fromEntries(bad));$('needs').append(b);}
 bars($('traits'),{curious:s.curious,playful:s.playful,lazy:s.lazy,brave:s.brave,affectionate:s.affectionate});
 $('senses').innerHTML=`${s.temp.toFixed(1)}°C · ${Math.round(s.humidity)}% humidity<br>`+
  `time ${s.clock} · battery ${s.charging?'plugged in':Math.round(s.battery*100)+'%'}`;
 $('log').innerHTML=s.log.map(e=>`<li>${e}</li>`).join('');
 $('brain').innerHTML=`Program version <b>${s.fw}</b> · brain v${s.brainVer} · voice v${s.voiceVer}<br>`+
  `Learned on the board: <b>${s.learnSteps}</b> decisions (moved ${(s.drift*100).toFixed(1)}% from the trained brain)<br>`+
  `Recent happiness score: ${s.recentReward.toFixed(2)} · snacks eaten: ${s.snacks}<br>`+
  `Updates: ${s.updateStatus}${s.latest>0?` (newest on GitHub: v${s.latest})`:''}`;
 $('files').innerHTML=s.sd?'<a href="/diary">Download diary (CSV)</a><a href="/sayings">Everything Pip said</a>':'No microSD card: the diary is off.';
}
function load(){fetch('/state').then(r=>r.json()).then(show).catch(()=>{})}
function pet(){fetch('/pet').then(r=>r.json()).then(show)}
function snack(){fetch('/snack').then(r=>r.json()).then(show)}
function upd(){$('brain').insertAdjacentText('beforeend',' · checking…');fetch('/update').then(r=>r.json()).then(show)}
// Give Pip the time from this phone (it has a clock chip but no internet time)
const d=new Date();
fetch(`/time?y=${d.getFullYear()}&mo=${d.getMonth()+1}&d=${d.getDate()}&wd=${d.getDay()}&h=${d.getHours()}&mi=${d.getMinutes()}&s=${d.getSeconds()}`).finally(load);
setInterval(load,10000);
</script></body></html>)rawliteral";

const char SETUP_HTML_TOP[] PROGMEM = R"rawliteral(<!doctype html>
<html><head><meta charset="utf-8"><meta name="viewport" content="width=device-width,initial-scale=1">
<title>Pip Wi-Fi setup</title><style>
body{font-family:-apple-system,system-ui,sans-serif;max-width:420px;margin:0 auto;padding:16px;background:#f4f1ea;color:#222}
label{display:block;margin:14px 0 4px;font-weight:600}
select,input,button{width:100%;box-sizing:border-box;font-size:18px;padding:12px;border:2px solid #222;border-radius:10px;background:#fff}
button{margin-top:20px;background:#222;color:#fff}
</style></head><body><h1>Connect Pip to Wi-Fi</h1>
<p>Pick your home network (2.4 GHz). The password is saved only on Pip.</p>
<form method="POST" action="/save"><label>Network</label><select name="ssid">)rawliteral";

const char SETUP_HTML_BOTTOM[] PROGMEM = R"rawliteral(</select>
<label>Or type a hidden network name</label><input name="other" autocapitalize="none">
<label>Password</label><input name="pass" type="password" autocomplete="off">
<button type="submit">Save and connect</button></form></body></html>)rawliteral";

String jsonEscape(const char *s) {
  String out;
  for (; *s; s++) {
    if (*s == '"' || *s == '\\') out += '\\';
    out += *s;
  }
  return out;
}

String htmlEscape(const String &s) {
  String out;
  for (char c : s) {
    if (c == '&') out += "&amp;"; else if (c == '<') out += "&lt;";
    else if (c == '>') out += "&gt;"; else if (c == '"') out += "&quot;"; else out += c;
  }
  return out;
}

void sendState() {
  int hr = (int)senses.hour, mn = (int)((senses.hour - hr) * 60);
  char clock[8];
  if (clockSet) snprintf(clock, sizeof(clock), "%02d:%02d", hr, mn); else snprintf(clock, sizeof(clock), "unset");
  String j = "{";
  j += "\"name\":\"" + jsonEscape(PET_NAME) + "\",";
  j += "\"personality\":\"" + jsonEscape(personalityWords().c_str()) + "\",";
  j += "\"thoughts\":" + String(thoughts) + ",";
  j += "\"action\":\"" + String(PIP_ACTION_NAMES[action]) + "\",";
  j += "\"reason\":\"" + jsonEscape(reason) + "\",";
  j += "\"said\":\"" + jsonEscape(speech) + "\",";
  j += "\"confidence\":" + String(actionProbs[action], 3) + ",";
  j += "\"food\":" + String(pip.food, 3) + ",\"energy\":" + String(pip.energy, 3) + ",";
  j += "\"fun\":" + String(pip.fun, 3) + ",\"comfort\":" + String(pip.comfort, 3) + ",";
  j += "\"social\":" + String(pip.social, 3) + ",";
  j += "\"grumpy\":" + String(pip.grumpy, 3) + ",\"sulky\":" + String(pip.sulky, 3) + ",";
  j += "\"scared\":" + String(pip.scared, 3) + ",\"frustrated\":" + String(pip.frustrated, 3) + ",";
  j += "\"curious\":" + String(traits.curious, 3) + ",\"playful\":" + String(traits.playful, 3) + ",";
  j += "\"lazy\":" + String(traits.lazy, 3) + ",\"brave\":" + String(traits.brave, 3) + ",";
  j += "\"affectionate\":" + String(traits.affectionate, 3) + ",";
  j += "\"temp\":" + String(senses.tempC, 2) + ",\"humidity\":" + String(senses.humidity, 1) + ",";
  j += "\"clock\":\"" + String(clock) + "\",";
  j += "\"battery\":" + String(senses.battery, 2) + ",\"charging\":" + String(senses.charging ? "true" : "false") + ",";
  j += "\"fw\":" + String(PIP_FW_VERSION) + ",\"brainVer\":" + String(PIP_BRAIN_VERSION) + ",\"voiceVer\":" + String(PV_VOICE_VERSION) + ",";
  j += "\"learnSteps\":" + String(learnSteps) + ",\"drift\":" + String(learnedDrift(), 4) + ",";
  j += "\"recentReward\":" + String(recentReward, 3) + ",\"snacks\":" + String(snackCount) + ",";
  j += "\"updateStatus\":\"" + jsonEscape(updateStatus.c_str()) + "\",\"latest\":" + String(latestVersion) + ",";
  j += "\"sd\":" + String(sdOk ? "true" : "false") + ",";
  j += "\"bloopHere\":" + String(bloopHere ? "true" : "false") + ",";
  j += "\"log\":[";
  for (int i = 0; i < logCount; i++) {
    char e[48];
    snprintf(e, sizeof(e), "%02d:%02d %s", actionLog[i].hour, actionLog[i].minute, PIP_ACTION_NAMES[actionLog[i].action]);
    j += String(i ? "," : "") + "\"" + e + "\"";
  }
  j += "]}";
  server.send(200, "application/json", j);
}

void sendSdFile(const char *path, const char *type) {
  if (!sdOk || !SD_MMC.exists(path)) { server.send(404, "text/plain", "Nothing on the microSD card yet."); return; }
  File f = SD_MMC.open(path, FILE_READ);
  server.streamFile(f, type);
  f.close();
}

void handlePet() {
  petPip();
  sendState();
}

void handleTime() {
  if (server.hasArg("y")) {
    writeRtc(server.arg("y").toInt(), server.arg("mo").toInt(), server.arg("d").toInt(), server.arg("wd").toInt(),
             server.arg("h").toInt(), server.arg("mi").toInt(), server.arg("s").toInt());
    int hr, mn;
    clockSet = readRtc(hr, mn);
    if (clockSet) senses.hour = hr + mn / 60.0f;
  }
  server.send(200, "text/plain", clockSet ? "ok" : "no clock");
}

void startSetupMode() {
  if (setupMode) return;
  setupMode = true;
  WiFi.mode(WIFI_AP_STA);
  int n = WiFi.scanNetworks();
  networkOptions = "";
  for (int i = 0; i < n; i++) {
    String name = WiFi.SSID(i);
    if (name.length() == 0 || networkOptions.indexOf(">" + htmlEscape(name) + "<") >= 0) continue;
    networkOptions += "<option value=\"" + htmlEscape(name) + "\">" + htmlEscape(name) + "</option>";
  }
  WiFi.softAP(SETUP_WIFI_NAME);
  dnsServer.start(53, "*", WiFi.softAPIP());
  snprintf(reason, sizeof(reason), "Join WiFi %s to set me up", SETUP_WIFI_NAME);
  needRedraw = true;
}

void handleRoot() {
  if (setupMode) {
    String page = FPSTR(SETUP_HTML_TOP);
    page += networkOptions;
    page += FPSTR(SETUP_HTML_BOTTOM);
    server.send(200, "text/html", page);
  } else {
    server.send_P(200, "text/html", PAGE_HTML);
  }
}

void handleSave() {
  String ssid = server.arg("other");
  ssid.trim();
  if (ssid.length() == 0) ssid = server.arg("ssid");
  wifiPrefs.putString("ssid", ssid);
  wifiPrefs.putString("pass", server.arg("pass"));
  server.send(200, "text/html",
              "<meta name=viewport content='width=device-width'><body style='font-family:sans-serif;padding:20px'>"
              "<h2>Saved!</h2><p>Pip is restarting and joining <b>" + htmlEscape(ssid) +
              "</b>.</p><p>Switch your phone back to your home Wi-Fi, then open <b>http://pip.local</b>.</p></body>");
  delay(1500);
  ESP.restart();
}

void handleNotFound() {
  if (setupMode) {
    server.sendHeader("Location", "http://" + WiFi.softAPIP().toString() + "/", true);
    server.send(302, "text/plain", "");
  } else {
    server.send(404, "text/plain", "Not found");
  }
}

void forgetWifi() {
  wifiPrefs.clear();
  snprintf(reason, sizeof(reason), "WiFi forgotten!");
  drawScreen();
  delay(1000);
  ESP.restart();
}

void startWifi() {
  wifiPrefs.begin("wifi", false);
  savedSsid = wifiPrefs.getString("ssid", "");
  savedPass = wifiPrefs.getString("pass", "");

  // Wi-Fi must be switched on BEFORE the web server starts, or the network
  // system isn't ready yet and the board crashes and restarts in a loop.
  WiFi.setHostname(WEB_NAME);
  WiFi.mode(WIFI_STA);
  server.on("/", handleRoot);
  server.on("/state", sendState);
  server.on("/pet", handlePet);
  server.on("/time", handleTime);
  server.on("/snack", []() { dropSnack(); sendState(); });
  server.on("/update", []() { checkForUpdate(); sendState(); });
  server.on("/diary", []() { sendSdFile("/pip/diary.csv", "text/csv"); });
  server.on("/sayings", []() { sendSdFile("/pip/sayings.txt", "text/plain"); });
  server.on("/save", HTTP_POST, handleSave);
  server.onNotFound(handleNotFound);
  server.begin();
  if (savedSsid.length() == 0) { startSetupMode(); return; }
  WiFi.begin(savedSsid.c_str(), savedPass.c_str());
  wifiStartedAt = lastWifiAttempt = millis();
}

void checkWifi() {
  if (setupMode) dnsServer.processNextRequest();
  if (savedSsid.length() == 0) return;
  if (!setupMode && !wifiWasConnected && WiFi.status() != WL_CONNECTED && millis() - wifiStartedAt > 30000) {
    startSetupMode();
  }
  bool connected = WiFi.status() == WL_CONNECTED;
  if (connected && !wifiWasConnected) {
    if (setupMode) {
      dnsServer.stop();
      WiFi.softAPdisconnect(true);
      WiFi.mode(WIFI_STA);
      setupMode = false;
    }
    configTime(0, 0, "pool.ntp.org", "time.google.com");  // correct time for HTTPS certificate checks
    MDNS.begin(WEB_NAME);
    MDNS.addService("http", "tcp", 80);
    Serial.printf("Wi-Fi connected: http://%s.local or http://%s\n", WEB_NAME, WiFi.localIP().toString().c_str());
    snprintf(reason, sizeof(reason), "Visit me: %s", WiFi.localIP().toString().c_str());
    needRedraw = true;
  } else if (!connected && wifiWasConnected) {
    MDNS.end();
  }
  if (!connected && !setupMode && millis() - lastWifiAttempt > 30000) {
    WiFi.reconnect();
    lastWifiAttempt = millis();
  }
  wifiWasConnected = connected;
}

// ================================================================ buttons

// The screen takes about half a second per frame, and the program can't look at the
// buttons while a frame is being drawn. So the buttons use interrupts: the instant
// a button changes, these tiny functions note it down, and checkButtons() acts on
// it right after the frame. (They read the GPIO register directly so they're safe
// to run at any moment.)
volatile bool isrBootDown = false, isrBootTap = false, isrPwrTap = false;
volatile unsigned long isrBootDownAt = 0, isrPwrAt = 0;
bool bootHoldUsed = false;

void IRAM_ATTR onBootChange() {
  unsigned long now = millis();
  bool down = !(REG_READ(GPIO_IN_REG) & BIT(BTN_BOOT));
  if (down && !isrBootDown) { isrBootDown = true; isrBootDownAt = now; }
  else if (!down && isrBootDown) {
    isrBootDown = false;
    unsigned long held = now - isrBootDownAt;
    if (held > 30 && held < 5000) isrBootTap = true;  // a tap (not a bounce, not the 5 s hold)
  }
}

void IRAM_ATTR onPwrPress() {
  unsigned long now = millis();
  if (now - isrPwrAt > 250) { isrPwrAt = now; isrPwrTap = true; }  // ignore switch bounce
}

void startButtons() {
  attachInterrupt(digitalPinToInterrupt(BTN_BOOT), onBootChange, CHANGE);
  attachInterrupt(digitalPinToInterrupt(BTN_PWR), onPwrPress, FALLING);
}

void checkButtons() {
  // Hold BOOT for 5 seconds: forget the Wi-Fi
  if (isrBootDown && !bootHoldUsed && millis() - isrBootDownAt > 5000) { bootHoldUsed = true; forgetWifi(); }
  if (!isrBootDown) bootHoldUsed = false;

  if (isrBootTap) {  // tap BOOT: drop a snack
    isrBootTap = false;
    Serial.println("BOOT tapped: snack!");
    dropSnack();
  }
  if (isrPwrTap) {   // tap PWR: pet Pip
    isrPwrTap = false;
    Serial.println("PWR tapped: pats!");
    petPip();
  }
}

// How Pip reacts to a pat depends on how it feels.
void petPip() {
  touchedPending = true;  // the brain feels it on its next thought (and updates the feelings)
  if (pip.sulky > 0.4f) {
    pip.sulky = pip_clamp01(pip.sulky - 0.15f);  // it's working... a little
    snprintf(reason, sizeof(reason), "...hmph.");
    speak('U', 8000);
  } else if (action == A_NAP && animMode == AN_REST) {
    pip.grumpy = pip_clamp01(pip.grumpy + 0.3f * (0.6f + 0.8f * traits.lazy));
    snprintf(reason, sizeof(reason), "Hmph! I was napping!");
    speak('G', 8000);
  } else {
    snprintf(reason, sizeof(reason), "Ooh, pats! <3");
    startHop();
    sayPetted();
  }
  needRedraw = true;
}

// ================================================================ radio: Pip and Bloop
// (See "Bloop comes to visit" above.)

void palOnRecv(const esp_now_recv_info_t *info, const uint8_t *data, int len) {
  (void)info;
  if (len < (int)sizeof(PalMsg) || memcmp(data, "PAL1", 4) != 0 || data[4] != PAL_BLOOP) return;
  bloopFlags = data[6];
  bloopHosting = data[7] != 0;
  bloopHeardMs = millis();
}

// "I'm Pip, I'm here": sent 4 times a second by a timer, so it keeps going even
// while the screen is busy drawing.
void palBeacon() {
  PalMsg m = {{'P', 'A', 'L', '1'}, PAL_PIP, palAction, palFlags, 0};
  esp_now_send(PAL_EVERYONE, (const uint8_t *)&m, sizeof(m));
}

void palStart() {
  if (esp_now_init() != ESP_OK) { Serial.println("Radio to Bloop: couldn't start"); return; }
  esp_now_register_recv_cb(palOnRecv);
  esp_now_peer_info_t peer = {};
  memcpy(peer.peer_addr, PAL_EVERYONE, 6);
  peer.channel = 0;   // whatever channel the Wi-Fi is on
  peer.ifidx = WIFI_IF_STA;
  peer.encrypt = false;
  palReady = esp_now_add_peer(&peer) == ESP_OK;
  if (palReady) palTicker.attach_ms(250, palBeacon);
}

// Run from loop(): notice Bloop arriving and leaving.
void visitTick() {
  if (!palReady) return;
  bool sad = min(min(pip.food, pip.energy), min(pip.fun, min(pip.comfort, pip.social))) < 0.25f;
  palAction = (uint8_t)action;
  palFlags = (sad ? PALF_SAD : 0) | (action == A_NAP ? PALF_ASLEEP : 0);

  uint32_t heard = bloopHeardMs;   // read this before the clock: the radio can update it at any moment
  bool together = bloopHosting && heard != 0 && millis() - heard < 5000;
  if (together == bloopHere) {
    if (bloopHere && bloopFlags != bloopFlagsDrawn) { bloopFlagsDrawn = bloopFlags; needRedraw = true; }
    return;
  }
  bloopHere = together;
  bloopFlagsDrawn = bloopFlags;
  // Normally the Wi-Fi radio naps between messages to save battery, which makes it
  // miss most of what Bloop says. While they're together, keep it wide awake.
  if (!setupMode) WiFi.setSleep(!bloopHere);
  if (bloopHere) {
    pip.social = pip_clamp01(pip.social + 0.2f);   // a friend came over!
    pip.fun = pip_clamp01(pip.fun + 0.15f);
    snprintf(reason, sizeof(reason), "Bloop came over!");
    if (action != A_NAP) {
      snprintf(speech, sizeof(speech), "Hi Bloop!");
      speechUntil = millis() + 8000;
      if (animMode == AN_REST) startHop();
    }
  } else {
    snprintf(reason, sizeof(reason), "Bye, Bloop!");
  }
  Serial.println(bloopHere ? "Bloop is here" : "Bloop went home");
  needRedraw = true;
}

// ================================================================ main

void setup() {
  pinMode(VBAT_PWR, OUTPUT); digitalWrite(VBAT_PWR, HIGH);
  pinMode(EPD_PWR, OUTPUT); digitalWrite(EPD_PWR, LOW);
  pinMode(BTN_BOOT, INPUT_PULLUP);
  pinMode(BTN_PWR, INPUT_PULLUP);
  startButtons();
  delay(100);
  Serial.begin(115200);
  delay(300);
  Serial.println("PipAI starting");

  Wire.begin(I2C_SDA, I2C_SCL);
  prefs.begin("pipai", false);
  loadOrBirth();
  loadLearning();
  startSD();
  Serial.printf("Personality: curious %.2f playful %.2f lazy %.2f brave %.2f affectionate %.2f (%s)\n",
                traits.curious, traits.playful, traits.lazy, traits.brave, traits.affectionate,
                personalityWords().c_str());

  SPI.begin(EPD_SCK, -1, EPD_MOSI, EPD_CS);
  display.init(115200, true, 2, false);
  display.setRotation(0);

  readSenses();
  for (int i = 0; i < PIP_N_ACTIONS; i++) actionProbs[i] = 0;
  actionProbs[action] = 1;
  drawScreen();
  startWifi();
  palStart();
  lastThink = millis() - THINK_EVERY_MS + 10000;  // first thought 10 s after start
}

void loop() {
  checkButtons();
  server.handleClient();
  checkWifi();
  if (millis() - lastThink >= THINK_EVERY_MS) {
    lastThink = millis();
    think();
  }
  animTick();
  speechTick();
  visitTick();
  updateTick();
  if (needRedraw) {
    needRedraw = false;
    drawScreen();
  }
  delay(20);
}
